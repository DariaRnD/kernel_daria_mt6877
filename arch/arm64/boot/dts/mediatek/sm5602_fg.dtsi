&i2c0{
		sm5602@71 {
		compatible = "sm,sm5602";
		reg = <0x71>;
		//interrupt-parent = <&pio>;
		//interrupts = <0 2>;
		mtk,irq-gpio = <&pio 18 0x0>;
		sm,en_temp_ex;
		//sm,en_temp_in;
		//sm,en_temp_3rd;
		sm,en_batt_det;
		sm,iocv_man_mode;
		sm,misc = <0x0800>;
		sm,misc2 = <0x0000>;
		sm,aging_ctrl = <0x0121>;
		sm,cycle_cfg = <0x7000>;
		sm,rsns = <0>;
		sm,fg_irq_set = <0x07FF>;
		sm,low_soc1 = <1>;
		sm,low_soc2 = <15>;
		sm,v_l_alarm = <3400>;
		sm,v_h_alarm = <4450>;
		sm,battery_table_num = <0>;
		sm,param_version = <2>;
		sm,t_l_alarm_in = <49>;
		sm,t_h_alarm_in = <1>;
		sm,t_l_alarm_ex = <0xE8E0>;
		sm,t_h_alarm_ex = <0x9E2B>;
		sm,shutdown-delay-enable;
		sm,rtrace = <0>;
		sm,rpara = <0x0>;
		sm,curr_voffset = <0>;
		sm,curr_vslope = <0x8080>;

		battery_params {
			battery,id = <0>;
			//1st battery
			battery0,param_version = <1>;
			battery0,max_voltage_uv = <4450000>;
			battery0,battery_type = <4450 0x0 0x2186>;
			battery0,battery_table0 = <0x1400 0x1B32 0x1C1D 0x1D03 0x1D6A 0x1D88 0x1D92 0x1DC0 0x1DF5 0x1E36 0x1E64 0x1E96 0x1EDA 0x1F0F 0x1F2E 0x1F96 0x2005 0x2093 0x20F5 0x219E 0x21EE 0x2291 0x22D3 0x2666>;
			battery0,battery_table1 = <0x0 0x66 0x1A8 0x3AF 0x535 0x7BE 0xBCC 0xF58 0x146A 0x1C04 0x2116 0x28B1 0x304B 0x355D 0x37E6 0x3CF7 0x4209 0x49A4 0x4EB5 0x5650 0x59DC 0x60F5 0x6400 0x64E6>;
			battery0,battery_table2 = <0x3A63 0x252C 0x1E21 0x1719 0x1315 0x1112 0x0F10 0x0F0F>;
			battery0,alpha = <0x00CC>;
			battery0,beta = <0x0025>;
			battery0,rs = <0x005F>;
			battery0,rs_value = <0x0050 0x010A 0x3800 0x0048>;
			battery0,vit_period = <0x315A>;
			battery0,volt_cal = <0x8000>;
			battery0,mix_value = <0x0003>;
			battery0,curr_offset = <0x000>;
			battery0,curr_slope = <0x8080>;
			battery0,topoff_soc = <7 1500 700>;
			battery0,temp_std = <25>;
			battery0,temp_offset = <0 11 1 0 8 (-1)>;
			battery0,temp_cal = <0 6 1 11 (-1) 0 6 1 9 1>;
			battery0,ext_temp_cal = <0 2 1 2 1 1 2 3 2 3>;
			battery0,tem_poff = <3400 100>;
			battery0,thermal_table = <
				0x506E 0x4F35 0x4E07 0x4CC0 0x4B76 0x4A25 0x48BD 0x475D 0x45F5 0x4477
				0x4304 0x4175 0x3FDE 0x3E4A 0x3CA2 0x3AF6 0x3945 0x378A 0x35CB 0x33FC
				0x322B 0x3059 0x2E82 0x2CA0 0x2AC6 0x28C6 0x26E0 0x24EA 0x22E8 0x20EF
				0x1EE7 0x1CEE 0x1AE8 0x18D0 0x16D6 0x14CE 0x12F3 0x10E4 0x0ED6 0x0CC4
				0x0ABC 0x08BC 0x06A8 0x04AD 0x02A1 0x009E 0xF669 0xF471 0xF278 0xF081
				0xEE7B 0xEC8C 0xEAA1 0xE8BE 0xE6E1 0xE505 0xE332 0xE162 0xDF9B 0xDDD9
				0xDC1F 0xDA67 0xD8B4 0xD70B 0xD565 0xD3C7 0xD232 0xD0A1 0xCF18 0xCD94
				0xCC18 0xCAA5 0xC936 0xC7D3 0xC670 0xC519 0xC3C6 0xC27A 0xC136 0xBFF7
				0xBEC1 0xBD92 0xBC6E 0xBB4D 0xBA36 0xB922 0xB816 0xB712 0xB611 0xB517
				0xB422 0xB334 0xB249 0xB164 0xB085 0xAFAD 0xAED8 0xAE0A 0xAD3E 0xAC78
				0xABB7>;			//NTC 10K/ PU_PD 20 table -20~80
		};
	};
};